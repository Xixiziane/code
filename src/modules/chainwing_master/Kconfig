## src/modules/chainwing_master/Kconfig
```kconfig
menuconfig MODULES_CHAINWING_MASTER
	bool "chainwing_master"
	default n
	---help---
		Enable support for chain-wing master communication module
```

## src/modules/chainwing_slave/Kconfig
```kconfig
menuconfig MODULES_CHAINWING_SLAVE
	bool "chainwing_slave"
	default n
	---help---
		Enable support for chain-wing slave controller
```
